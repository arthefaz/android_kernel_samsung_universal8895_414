/*
 * SAMSUNG EXYNOS device tree source for reserved-memory
 *
 * Copyright (c) 2017 Samsung Electronics Co., Ltd.
 *		http://www.samsung.com
 *
 * This program is free software; you can redistribute it and/or modify
 * it under the terms of the GNU General Public License version 2 as
 * published by the Free Software Foundation.
 */

&reserved_memory {
	camera {
			compatible = "exynos9820-ion";
			ion,recyclable;
			size = <0x1b800000>;
			alloc-ranges = <0x0 0x40000000 0xc0000000>;
			alignment = <0x0 0x400000>;
			ion,protection_id = <0xa>;
			ion,heapname = "camera_heap";
		};

		camera_contig {
			compatible = "exynos9820-ion";
			size = <0x46a000>;
			alloc-ranges = <0x0 0x40000000 0xc0000000>;
			alignment = <0x0 0x400000>;
			ion,protection_id = <0xc>;
			ion,heapname = "camera_contig_heap";
		};
};
